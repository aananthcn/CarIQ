## build-ccn/conf/bblayers.conf
```bitbake
# POKY_BBLAYERS_CONF_VERSION is increased each time build/conf/bblayers.conf
# changes incompatibly
POKY_BBLAYERS_CONF_VERSION = "2"

BBPATH = "${TOPDIR}"
BBFILES ?= ""

BBLAYERS ?= " \
  ${TOPDIR}/../yocto/poky/meta \
  ${TOPDIR}/../yocto/poky/meta-poky \
  ${TOPDIR}/../yocto/poky/meta-yocto-bsp \
  ${TOPDIR}/../yocto/meta-meson \
  ${TOPDIR}/../yocto/meta-openembedded/meta-oe \
  ${TOPDIR}/../yocto/meta-openembedded/meta-python \
  ${TOPDIR}/../yocto/meta-openembedded/meta-networking \
  ${TOPDIR}/../yocto/meta-openembedded/meta-gnome \
  ${TOPDIR}/../yocto/meta-openembedded/meta-multimedia \
  ${TOPDIR}/../yocto/meta-openembedded/meta-xfce \
  ${TOPDIR}/../yocto/meta-ros/meta-ros-common \
  ${TOPDIR}/../yocto/meta-ros/meta-ros1 \
  ${TOPDIR}/../yocto/meta-ros/meta-ros1-noetic \
  ${TOPDIR}/../yocto/meta-cariq \
  "
```

## build-nv-en1/conf/bblayers.conf
```bitbake
# POKY_BBLAYERS_CONF_VERSION is increased each time build/conf/bblayers.conf
# changes incompatibly
POKY_BBLAYERS_CONF_VERSION = "2"

BBPATH = "${TOPDIR}"
BBFILES ?= ""

BBLAYERS ?= " \
  ${TOPDIR}/../yocto/poky/meta \
  ${TOPDIR}/../yocto/poky/meta-poky \
  ${TOPDIR}/../yocto/poky/meta-yocto-bsp \
  ${TOPDIR}/../yocto/meta-raspberrypi \
  ${TOPDIR}/../yocto/meta-openembedded/meta-oe \
  ${TOPDIR}/../yocto/meta-openembedded/meta-python \
  ${TOPDIR}/../yocto/meta-openembedded/meta-networking \
  ${TOPDIR}/../yocto/meta-openembedded/meta-gnome \
  ${TOPDIR}/../yocto/meta-openembedded/meta-multimedia \
  ${TOPDIR}/../yocto/meta-openembedded/meta-xfce \
  ${TOPDIR}/../yocto/meta-ros/meta-ros-common \
  ${TOPDIR}/../yocto/meta-ros/meta-ros2 \
  ${TOPDIR}/../yocto/meta-ros/meta-ros2-humble \
  ${TOPDIR}/../yocto/meta-cariq \
  "
```

## build-ss-en1/conf/bblayers.conf
```bitbake
# POKY_BBLAYERS_CONF_VERSION is increased each time build/conf/bblayers.conf
# changes incompatibly
POKY_BBLAYERS_CONF_VERSION = "2"

BBPATH = "${TOPDIR}"
BBFILES ?= ""

BBLAYERS ?= " \
  ${TOPDIR}/../yocto-layer/poky/meta \
  ${TOPDIR}/../yocto-layer/poky/meta-poky \
  ${TOPDIR}/../yocto-layer/poky/meta-yocto-bsp \
  ${TOPDIR}/../yocto-layer/meta-raspberrypi \
  ${TOPDIR}/../yocto-layer/meta-openembedded/meta-oe \
  ${TOPDIR}/../yocto-layer/meta-openembedded/meta-python \
  ${TOPDIR}/../yocto-layer/meta-openembedded/meta-networking \
  ${TOPDIR}/../yocto-layer/meta-openembedded/meta-gnome \
  ${TOPDIR}/../yocto-layer/meta-openembedded/meta-multimedia \
  ${TOPDIR}/../yocto-layer/meta-openembedded/meta-xfce \
  ${TOPDIR}/../yocto-layer/meta-ara \
  ${TOPDIR}/../yocto-layer/meta-ros/meta-ros-common \
  ${TOPDIR}/../yocto-layer/meta-ros/meta-ros1 \
  ${TOPDIR}/../yocto-layer/meta-ros/meta-ros1-noetic \
  ${TOPDIR}/../yocto-layer/meta-cariq \
  "
```

## build/conf/bblayers.conf
```bitbake
# POKY_BBLAYERS_CONF_VERSION is increased each time build/conf/bblayers.conf
# changes incompatibly
POKY_BBLAYERS_CONF_VERSION = "2"

BBPATH = "${TOPDIR}"
BBFILES ?= ""

BBLAYERS ?= " \
  ${BBPATH}/poky/meta \
  ${BBPATH}/poky/meta-poky \
  ${BBPATH}/poky/meta-yocto-bsp \
  ${BBPATH}/meta-meson \
  ${BBPATH}/meta-openembedded/meta-oe \
  ${BBPATH}/meta-openembedded/meta-python \
  ${BBPATH}/meta-openembedded/meta-networking \
  ${BBPATH}/meta-openembedded/meta-gnome \
  ${BBPATH}/meta-openembedded/meta-multimedia \
  ${BBPATH}/meta-openembedded/meta-xfce \
  "
```

## yocto-layer/meta-cariq/conf/distro/cariq.conf
```bitbake
DISTRO_NAME = "CarIQ Platform"
DISTRO_VERSION = "${CARIQ_SW_VERSION}"

DISTRO_FEATURES = "alsa argp bluetooth ipv4 ipv6 largefile pcmcia usbgadget usbhost \
	wifi nfs zeroconf ptest systemd vfat opengl pulseaudio x11"

TCLIBCAPPEND = ""
```

## yocto-layer/meta-cariq/conf/layer.conf
```bitbake
# We have a conf and classes directory, add to BBPATH
BBPATH .= ":${LAYERDIR}"

# We have recipes-* directories, add to BBFILES
BBFILES += "${LAYERDIR}/recipes-*/*/*.bb ${LAYERDIR}/recipes-*/*/*.bbappend"

BBFILE_COLLECTIONS += "cariq"
BBFILE_PATTERN_cariq = "^${LAYERDIR}/"
BBFILE_PRIORITY_cariq = "20"
LAYERSERIES_COMPAT_cariq = "kirkstone scarthgap"

# This should only be incremented on significant changes that will
# cause compatibility issues with other layers
LAYERVERSION_cariq = "1"

LAYERDEPENDS_cariq = "core"

LAYER_PRIORITY_cariq = "10"
```

## yocto/meta-car_iq/conf/layer.conf
```bitbake
# We have a conf and classes directory, add to BBPATH
BBPATH .= ":${LAYERDIR}"

# We have recipes-* directories, add to BBFILES
BBFILES += "${LAYERDIR}/recipes-*/*/*.bb ${LAYERDIR}/recipes-*/*/*.bbappend"

BBFILE_COLLECTIONS += "car_iq"
BBFILE_PATTERN_car_iq = "^${LAYERDIR}/"
BBFILE_PRIORITY_car_iq = "1"
LAYERSERIES_COMPAT_car_iq = "styhead"

# This should only be incremented on significant changes that will
# cause compatibility issues with other layers
LAYERVERSION_car_iq = "1"

LAYERDEPENDS_car_iq = "core"
```

## yocto/meta-cariq/wic/sdimage-cariq-ccn.wks
```
# short-description: Create SD card image with boot, update, and root partitions for Khadas VIM3 (Central Compute Node)
# long-description: Creates a partitioned SD card image. Boot files are located in the first vfat partition, an update partition in the second, and the root filesystem at the end.


# Boot partition
part /boot --source bootimg-partition --fstype=vfat --label boot --active --align 4096 --size 64 --sourceparams="loader=u-boot" --use-uuid

# Update partition (fixed 4 GB size)
#part /update --source rawcopy --fstype=ext4 --label update --align 4096 --size 4032 --sourceparams="file=update.ext4"
part /update --source rawcopy --fstype=ext4 --label update --align 4096 --size 4032 --sourceparams="file=update.ext4" --use-uuid --fsuuid a234f914-257f-4ae7-8ebf-614ddf817799

# Root filesystem partition 
part / --source rootfs --fstype=ext4 --use-uuid --label root --align 4096

# Partition Table description
bootloader --ptable msdos --append="console=ttyAML0,115200"
```

## yocto/meta-cariq/wic/sdimage-cariq-en1.wks
```
# short-description: Create Raspberry Pi SD card image
# long-description: Creates a partitioned SD card image for use with
# Raspberry Pi. Boot files are located in the first vfat partition.

# Boot partition (kernel image goes here)
part /boot --source rootfs --rootfs-dir=${DEPLOY_DIR_IMAGE}/bootfiles --ondisk mmcblk0 --fstype=vfat --label boot --active --align 4096 --size 512 --extra-space 0

# Update partition for OTA (fixed ~4 GB size)
part /update --source rawcopy --fstype=ext4 --label update --align 4096 --size 4096 --sourceparams="file=update.ext4" --use-uuid --fsuuid a234f914-257f-4ae7-8ebf-614ddf817799

# Root filesystem partition 
part / --source rootfs --ondisk mmcblk0 --fstype=ext4 --label root --align 4096
```
