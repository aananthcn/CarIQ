## build-aas/conf/bblayers.conf
```bitbake
# POKY_BBLAYERS_CONF_VERSION is increased each time build/conf/bblayers.conf
# changes incompatibly
POKY_BBLAYERS_CONF_VERSION = "2"

BBPATH = "${TOPDIR}"
BBFILES ?= ""

BBLAYERS ?= " \
  ${TOPDIR}/../yocto-layer/poky/meta \
  ${TOPDIR}/../yocto-layer/poky/meta-poky \
  ${TOPDIR}/../yocto-layer/poky/meta-yocto-bsp \
  ${TOPDIR}/../yocto-layer/meta-raspberrypi \
  ${TOPDIR}/../yocto-layer/meta-openembedded/meta-oe \
  ${TOPDIR}/../yocto-layer/meta-openembedded/meta-python \
  ${TOPDIR}/../yocto-layer/meta-openembedded/meta-networking \
  ${TOPDIR}/../yocto-layer/meta-openembedded/meta-gnome \
  ${TOPDIR}/../yocto-layer/meta-openembedded/meta-multimedia \
  ${TOPDIR}/../yocto-layer/meta-openembedded/meta-xfce \
  ${TOPDIR}/../yocto-layer/meta-openembedded/meta-perl \
  ${TOPDIR}/../yocto-layer/meta-opendds \
  ${TOPDIR}/../yocto-layer/meta-ara \
  ${TOPDIR}/../yocto-layer/meta-cariq \
  "
```
